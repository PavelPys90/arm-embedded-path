# file: 001_LED_Blink.ioc
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Mcu.Family=STM32F1
Mcu.Name=STM32F103C(4-6)Tx
Mcu.Package=LQFP48
NVIC.PriorityGroup=NVIC_PRIORITYGROUP_4
PA13.Mode=Serial_Wire
PA13.Signal=SYS_JTMS-SWDIO
PA14.Mode=Serial_Wire
PA14.Signal=SYS_JTCK-SWCLK
ProjectManager.HeapSize=0x200
ProjectManager.StackSize=0x400
ProjectManager.TargetToolchain=STM32CubeIDE
RCC.APB1Freq_Value=8000000
RCC.APB2Freq_Value=8000000
board=custom

// file: Core/Src/main.c
/* USER CODE BEGIN Header */
/**
  ******************************************************************************
  * @file           : main.c
  * @brief          : Main program body
  ******************************************************************************
  * @attention
  *
  * Copyright (c) 2025 STMicroelectronics.
  * All rights reserved.
  *
  * This software is licensed under terms that can be found in the LICENSE file
  * in the root directory of this software component.
  * If no LICENSE file comes with this software, it is provided AS-IS.
  *
  ******************************************************************************
  */
/* USER CODE END Header */
#include "main.h"

/* USER CODE BEGIN PV */
volatile uint32_t msTicks = 0;
/* USER CODE END PV */

void SystemClock_Config(void);
static void MX_GPIO_Init(void);
/* USER CODE BEGIN PFP */
void delay_ms(uint32_t ms);
void GPIO_LED_Init(void);
/* USER CODE END PFP */

/* USER CODE BEGIN 0 */

// Delay-Function by SysTick
void delay_ms(uint32_t ms){
	uint32_t startTicks = msTicks;
	while ((msTicks - startTicks)<ms);
}
// GPIO PC13 (LED) init with CMSIS
void GPIO_LED_Init(void) {
    // ==========================================================================
    // CLOCK CONFIGURATION - Enable GPIO Port C clock
    // ==========================================================================

    // APPROACH 1: Using STM32 HAL macros (recommended for readability)
    RCC->APB2ENR |= RCC_APB2ENR_IOPCEN;

    // APPROACH 2: Direct bit manipulation (sets bit 4)
    // RCC->APB2ENR |= (1u << 4);

    // ==========================================================================
    // PIN CONFIGURATION - Configure PC13 as Push-Pull Output, 2MHz
    // ==========================================================================

    // APPROACH 1: Using STM32 HAL macros (recommended)
    // Clear MODE13 and CNF13 bits (bits 20-23 for PC13 in CRH register)
    GPIOC->CRH &= ~(GPIO_CRH_CNF13 | GPIO_CRH_MODE13);
    // Set MODE13 to 10 (2MHz output), CNF13 remains 00 (Push-Pull)
    GPIOC->CRH |= GPIO_CRH_MODE13_1;

    // APPROACH 2: Direct bit manipulation
    // Clear all 4 configuration bits for PC13 (bits 20-23)
    // GPIOC->CRH &= ~(0xFu << 20);
    // Set configuration: CNF=00, MODE=10 (0b0010 = 0x2)
    // GPIOC->CRH |= (0x2u << 20);

    // ==========================================================================
    // INITIAL STATE - Set LED to OFF state (PC13 high for active-low LED)
    // ==========================================================================

    // Set PC13 to HIGH (LED off for active-low configuration)
    GPIOC->BSRR = GPIO_BSRR_BS13;

    // Alternative direct bit manipulation:
    // GPIOC->BSRR = (1u << 13);
}
/* USER CODE END 0 */

int main(void)
{

  /* MCU Configuration--------------------------------------------------------*/

  /* Reset of all peripherals, Initializes the Flash interface and the Systick. */
  HAL_Init();

  /* Configure the system clock */
  SystemClock_Config();

  /* USER CODE BEGIN SysInit */
  SysTick_Config(SystemCoreClock / 1000);
  GPIO_LED_Init();
  /* USER CODE END SysInit */

  /* Initialize all configured peripherals */
  MX_GPIO_Init();

  /* Infinite loop */
  while (1)
  {

    /* USER CODE BEGIN 3 */
	// LED On
	  //GPIOC->BSRR = GPIO_BSRR_BR13;
	  GPIOC->BSRR = (1u << (13+16));
	  delay_ms(1000);

	  //GPIOC->BSRR = GPIO_BSRR_BS13;
	  GPIOC->BSRR = (1u << 13);
	  delay_ms(1000);
  }
  /* USER CODE END 3 */
}

void SystemClock_Config(void)
{
  RCC_OscInitTypeDef RCC_OscInitStruct = {0};
  RCC_ClkInitTypeDef RCC_ClkInitStruct = {0};

  /** Initializes the RCC Oscillators according to the specified parameters
  * in the RCC_OscInitTypeDef structure.
  */
  RCC_OscInitStruct.OscillatorType = RCC_OSCILLATORTYPE_HSI;
  RCC_OscInitStruct.HSIState = RCC_HSI_ON;
  RCC_OscInitStruct.HSICalibrationValue = RCC_HSICALIBRATION_DEFAULT;
  RCC_OscInitStruct.PLL.PLLState = RCC_PLL_NONE;
  if (HAL_RCC_OscConfig(&RCC_OscInitStruct) != HAL_OK)
  {
    Error_Handler();
  }

  /** Initializes the CPU, AHB and APB buses clocks
  */
  RCC_ClkInitStruct.ClockType = RCC_CLOCKTYPE_HCLK|RCC_CLOCKTYPE_SYSCLK
                              |RCC_CLOCKTYPE_PCLK1|RCC_CLOCKTYPE_PCLK2;
  RCC_ClkInitStruct.SYSCLKSource = RCC_SYSCLKSOURCE_HSI;
  RCC_ClkInitStruct.AHBCLKDivider = RCC_SYSCLK_DIV1;
  RCC_ClkInitStruct.APB1CLKDivider = RCC_HCLK_DIV1;
  RCC_ClkInitStruct.APB2CLKDivider = RCC_HCLK_DIV1;

  if (HAL_RCC_ClockConfig(&RCC_ClkInitStruct, FLASH_LATENCY_0) != HAL_OK)
  {
    Error_Handler();
  }
}

static void MX_GPIO_Init(void)
{

  /* GPIO Ports Clock Enable */
  __HAL_RCC_GPIOA_CLK_ENABLE();

}

void Error_Handler(void)
{
  __disable_irq();
  while (1)
  {
  }
}
